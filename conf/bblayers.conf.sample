## conf/bblayers.conf.sample
```bitbake
# LAYER_CONF_VERSION is increased each time build/conf/bblayers.conf
# changes incompatibly
LCONF_VERSION = "6"

BBPATH = "${TOPDIR}"
BBFILES ?= ""

BBLAYERS ?= " \
  /home/scott/poky-dylan/meta \
  /home/scott/poky-dylan/meta-yocto \
  /home/scott/poky-dylan/meta-gumstix \
  /home/scott/poky-dylan/meta-beagleboard/common-bsp \
  /home/scott/jumpnow-dylan/meta-jumpnow \
  "

BBLAYERS_NON_REMOVABLE ?= " \
  /home/scott/poky-dylan/meta \
  /home/scott/poky-dylan/meta-yocto \
  "
```

## conf/layer.conf
```bitbake
# We have a conf and classes directory, append to BBPATH
BBPATH .= ":${LAYERDIR}"

# We have a recipes directory, add to BBFILES
BBFILES += "${LAYERDIR}/recipes*/*/*.bb ${LAYERDIR}/recipes*/*/*.bbappend"

BBFILE_COLLECTIONS += "meta-jumpnow"
BBFILE_PATTERN_meta-jumpnow := "^${LAYERDIR}/"
BBFILE_PRIORITY_meta-jumpnow = "16"
```

## conf/local.conf.sample
```bitbake
# Local configuration for meta-jumpnow images
# Used primarily for Gumstix Overo and Duovero systems
# Yocto Project 1.4 Poky distribution 9.0, [dylan] branch

# From [denzil] branch, until I decide whether to bring in meta-openembedded
BBMASK = "meta-jumpnow/recipes-graphics"
BBMASK .= "|meta-jumpnow/recipes-support/opencv"
# just started with this, not working yet
BBMASK .= "|meta-beagleboard"

# This is sufficient for most of our projects
DISTRO_FEATURES = "alsa directfb ext2 keyboard serial usbgadget usbhost wifi ${DISTRO_FEATURES_LIBC}"

# Additional distro features you might want to add: 
# 3g, bluetooth, irda, nfc, nfs, pci, vfat, x11, zeroconf 

# force this output type for all MACHINES, significantly smaller in size
IMAGE_FSTYPES_forcevariable = "tar.xz"

# override the mix in the meta-gumstix/conf/machine configuration files
MACHINE_FEATURES_forcevariable = "alsa ext3 kernel26 screen uboot usbgadget usbhost vfat"

BB_NUMBER_THREADS = "4"
PARALLEL_MAKE = "-j 4"

#MACHINE ?= "overo"
# if mcbsp is required, have to use the 3.2 kernel
#PREFERRED_VERSION_linux-gumstix = "3.2"

MACHINE ?= "duovero"

DL_DIR ?= "/oe-sources"

#SSTATE_DIR ?= "${TOPDIR}/sstate-cache"

TMPDIR = "/oe16/tmp-poky-dylan-build"

DISTRO = "poky"

PACKAGE_CLASSES = "package_ipk"

# i686 or x86_64
SDKMACHINE = "x86_64"

EXTRA_IMAGE_FEATURES = "debug-tweaks"

USER_CLASSES ?= "image-mklibs image-prelink"

PATCHRESOLVE = "noop"

#
# Disk Space Monitoring during the build
#
# Monitor the disk space during the build. If there is less that 1GB of space or less
# than 100K inodes in any key build location (TMPDIR, DL_DIR, SSTATE_DIR), gracefully
# shutdown the build. If there is less that 100MB or 1K inodes, perform a hard abort
# of the build. The reason for this is that running completely out of space can corrupt
# files and damages the build in ways which may not be easily recoverable.
BB_DISKMON_DIRS = "\
    STOPTASKS,${TMPDIR},1G,100K \
    STOPTASKS,${DL_DIR},1G,100K \
    STOPTASKS,${SSTATE_DIR},1G,100K \
    ABORT,${TMPDIR},100M,1K \
    ABORT,${DL_DIR},100M,1K \
    ABORT,${SSTATE_DIR},100M,1K" 


CONF_VERSION = "1"
```

## conf/machine/duovero.conf
```bitbake
#@TYPE: Machine
#@NAME: duovero
#@DESCRIPTION: Machine configuration for the Gumstix duovero

require conf/machine/include/duovero-jumpnow.inc

EXTRA_IMAGEDEPENDS += "u-boot-sakoman"

PREFERRED_PROVIDER_virtual/bootloader = "u-boot-sakoman"
UBOOT_MACHINE = "omap4_duovero_config"

PREFERRED_PROVIDER_virtual/kernel = "linux-sakoman"

IMAGE_FSTYPES += "tar.bz2"

SERIAL_CONSOLE = "115200 ttyO2"

MACHINE_EXTRA_RRECOMMENDS = " kernel-modules"
MACHINE_FEATURES = "alsa ext2 vfat keyboard screen serial touchscreen usbgadget usbhost uboot wifi"
```

## conf/machine/overo.conf
```bitbake
#@TYPE: Machine
#@NAME: Overo machine
#@DESCRIPTION: Machine configuration for the Gumstix Overo

require conf/machine/include/omap3-sakoman.inc

EXTRA_IMAGEDEPENDS += "u-boot-sakoman"

PREFERRED_PROVIDER_virtual/bootloader = "u-boot-sakoman"
UBOOT_MACHINE = "omap3_overo_config"

PREFERRED_PROVIDER_virtual/kernel = "linux-sakoman"
#PREFERRED_PROVIDER_virtual/kernel = "linux-omap3"

PREFERRED_PROVIDER_virtual/xserver = "xserver-xorg"
XSERVER = "xserver-xorg \
           xf86-input-evdev \
           xf86-input-mouse \
           xf86-video-omapfb \
           xf86-input-keyboard"

IMAGE_FSTYPES += "tar.bz2"

SERIAL_CONSOLE = "115200 ttyO2"

MACHINE_EXTRA_RRECOMMENDS = " kernel-modules"
MACHINE_FEATURES = "kernel26 alsa ext2 vfat keyboard screen serial touchscreen usbgadget usbhost uboot"
```
